## kernel/Kconfig
```kconfig
#
# virtio-nic-driver: Kconfig fragment
#

config VIRTIO_NIC
    bool "VirtIO Paravirtualized NIC front-end driver"
    depends on PCI && VIRTIO_PCI
    help
      Enable support for the next-gen VirtIO NIC driver with multi-AZ resilience.
```
